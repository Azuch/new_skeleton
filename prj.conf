## CMakeLists.txt
```
cmake_minimum_required(VERSION 3.20.0)

find_package(Zephyr REQUIRED HINTS $ENV{ZEPHYR_BASE})
project(demo_skeleton)

FILE(GLOB app_sources src/*.c)
target_sources(app PRIVATE ${app_sources})

set(gen_dir ${ZEPHYR_BINARY_DIR}/include/generated/)

generate_inc_file_for_target(
    app
    src/r1.der
    ${gen_dir}/r1.der.inc
    )
```

## Kconfig
```
source "Kconfig.zephyr"

# Kconfig for New Skeleton Application

mainmenu "New Skeleton Application"

config APP_WIFI_SSID
    string "WiFi SSID"
    default ""
    help
      The SSID of the WiFi network to connect to.

config APP_WIFI_PSK
    string "WiFi Password"
    default ""
    help
      The password for the WiFi network.

config APP_HTTP_HOST
    string "HTTP Server Hostname"
    default "localhost"
    help
      The hostname of the HTTP server to connect to.

config APP_HTTP_IP
    string "HTTP Server IP Address"
    default "192.168.0.189"
    help
      The IP address of the HTTP server.

config APP_HTTP_PORT
    int "HTTP Server Port"
    default 8080
    help
      The port for the HTTP server.

config APP_HTTPS_PORT
    int "HTTPS Server Port"
    default 9443
    help
      The port for the HTTPS server.

config APP_HTTP_PATH
    string "HTTP Data Path"
    default "/data"
    help
      The path for posting data on the HTTP server.

config APP_OTA_PATH
    string "OTA Update Path"
    default "/ota"
    help
      The path for Over-The-Air updates on the HTTP server.
```

## prj.conf
```kconfig
CONFIG_INIT_STACKS=y

CONFIG_TEST_RANDOM_GENERATOR=y

CONFIG_LOG=y
CONFIG_LOG_DEFAULT_LEVEL=3
CONFIG_MAIN_STACK_SIZE=8192

CONFIG_WATCHDOG=y
```

## overlay_tls.conf
```kconfig
CONFIG_MAIN_STACK_SIZE=3072
CONFIG_NET_BUF_RX_COUNT=80
CONFIG_NET_BUF_TX_COUNT=80

# TLS configuration
CONFIG_MBEDTLS=y
CONFIG_MBEDTLS_BUILTIN=y
CONFIG_MBEDTLS_ENABLE_HEAP=y
CONFIG_MBEDTLS_HEAP_SIZE=60000
CONFIG_MBEDTLS_SSL_MAX_CONTENT_LEN=2048
CONFIG_MBEDTLS_KEY_EXCHANGE_ECDHE_RSA_ENABLED=y
CONFIG_PSA_WANT_KEY_TYPE_ECC_KEY_PAIR_IMPORT=y
CONFIG_PSA_WANT_KEY_TYPE_ECC_KEY_PAIR_EXPORT=y
CONFIG_PSA_WANT_KEY_TYPE_ECC_KEY_PAIR_GENERATE=y
CONFIG_PSA_WANT_KEY_TYPE_ECC_KEY_PAIR_DERIVE=y
CONFIG_PSA_WANT_KEY_TYPE_RSA_KEY_PAIR_IMPORT=y
CONFIG_PSA_WANT_KEY_TYPE_RSA_KEY_PAIR_EXPORT=y
CONFIG_PSA_WANT_KEY_TYPE_RSA_KEY_PAIR_GENERATE=y
CONFIG_PSA_WANT_ECC_SECP_R1_256=y
CONFIG_PSA_WANT_ALG_ECDH=y
CONFIG_PSA_WANT_ALG_ECDSA=y

CONFIG_NET_SOCKETS_SOCKOPT_TLS=y
CONFIG_NET_SOCKETS_TLS_MAX_CONTEXTS=6
```

## tls.conf
```kconfig
CONFIG_DNS_RESOLVER_AI_MAX_ENTRIES=10
CONFIG_DNS_RESOLVER=y

CONFIG_HTTP_CLIENT=y

CONFIG_MBEDTLS_BUILTIN=y
CONFIG_MBEDTLS_ENABLE_HEAP=y
CONFIG_MBEDTLS_HEAP_SIZE=60000
CONFIG_MBEDTLS_PSA_CRYPTO_C=y
CONFIG_MBEDTLS_PSA_CRYPTO_EXTERNAL_RNG=y
CONFIG_MBEDTLS_PSA_KEY_SLOT_COUNT=16
CONFIG_MBEDTLS_SERVER_NAME_INDICATION=y
CONFIG_MBEDTLS_SSL_MAX_CONTENT_LEN=8192
CONFIG_MBEDTLS=y

CONFIG_NET_BUF_RX_COUNT=20
CONFIG_NET_BUF_RX_COUNT=80
CONFIG_NET_BUF_TX_COUNT=20
CONFIG_NET_BUF_TX_COUNT=80

CONFIG_NET_CONFIG_INIT_TIMEOUT=1
CONFIG_NET_CONFIG_SETTINGS=y

CONFIG_NET_CONTEXT_NET_PKT_POOL=y

CONFIG_NET_DHCPV4=y
CONFIG_NET_HTTP_LOG_LEVEL_DBG=n
CONFIG_NET_IPV4=y
CONFIG_NET_IPV6_LOG_LEVEL_DBG=n
CONFIG_NET_IPV6_ND_LOG_LEVEL_DBG=n
CONFIG_NET_IPV6=y
CONFIG_NET_L2_ETHERNET=y
CONFIG_NET_L2_WIFI_MGMT=y
CONFIG_NET_LOG=y
CONFIG_NET_MAX_CONTEXTS=10
CONFIG_NET_PKT_RX_COUNT=10
CONFIG_NET_PKT_TX_COUNT=10
CONFIG_NET_RX_STACK_SIZE=2048
CONFIG_NET_SOCKETS_LOG_LEVEL_DBG=n
CONFIG_NET_SOCKETS_SOCKOPT_TLS=y
CONFIG_NET_SOCKETS_TLS_MAX_CONTEXTS=6
CONFIG_NET_SOCKETS=y
CONFIG_NET_TCP_ISN_RFC6528=y
CONFIG_NET_TCP=y
CONFIG_NET_TX_STACK_SIZE=2048
CONFIG_NET_UDP=y

CONFIG_NETWORKING=y

CONFIG_POSIX_API=y

CONFIG_PSA_CRYPTO_ENABLE_ALL=y
CONFIG_PSA_CRYPTO_PROVIDER_MBEDTLS=y
CONFIG_PSA_CRYPTO=y

CONFIG_WIFI=y

CONFIG_ZVFS_POLL_MAX=4
```

## boards/esp32s3_devkitc.conf
```kconfig
CONFIG_HEAP_MEM_POOL_SIZE=65536
```

## boards/esp32s3_devkitc.overlay
```dts
&wifi {
	status = "okay";
}
```

## src/main.c
```c
#include "app.h"


int main(void) {
	app_run();
	return 0;
}
```

## src/app.c
```c
#include "app.h"
#include "system_event.h"
#include "sensor_fsm.h"
#include "wifi_fsm.h"
#include "http_fsm.h"
#include <zephyr/logging/log.h>
#include <zephyr/drivers/watchdog.h>
#include <zephyr/device.h>

LOG_MODULE_REGISTER(APP, LOG_LEVEL_INF);

static struct g_app {
	int count;
} g_app;

static const struct device *wdt_dev;
static int wdt_channel_id;

void watchdog_init(void) {
	wdt_dev = DEVICE_DT_GET(DT_ALIAS(watchdog0));
	if (!device_is_ready(wdt_dev)) {
		LOG_ERR("Error in boot  watchdog");
	}

	struct wdt_timeout_cfg cfg = {
		.window = {
			.min = 0,
			.max = 15000,
		},
		.callback = NULL,
		.flags = WDT_FLAG_RESET_SOC,
	};

	wdt_channel_id = wdt_install_timeout(wdt_dev, &cfg);
	if (wdt_channel_id < 0) {
		LOG_ERR("Error in create watchdog channel");
	}

	if (wdt_setup(wdt_dev, 0) < 0) {
		LOG_ERR("ERROR in setup watchdog");
	}
}

void watchdog_kick(void) {
	wdt_feed(wdt_dev, wdt_channel_id);
}

void app_run(void) {
	g_app.count++;
	LOG_INF("Started: %d", g_app.count);

	sensor_fsm_init();
	wifi_fsm_init();
	http_fsm_init();

	system_event_post(EVENT_START);
	enum system_event evt;
	watchdog_init();
	while(1) {

		sensor_fsm_step();
		wifi_fsm_step();
		http_fsm_step();

		system_event_get(&evt);
		
		switch(evt) {
			case EVENT_START:
				LOG_INF("Event start catched");
				break;
			default:
				LOG_ERR("Error in catching event");
				break;
		}
		system_event_post(EVENT_START);
		watchdog_kick();
	}
}
	
```

## src/ca_certificate.h
```c
static const unsigned char ca_certificate[] = {
#include "r1.der.inc"
};
```

## src/certs.h
```c
#pragma once

static const unsigned char ca_certificate[] = 
"-----BEGIN CERTIFICATE-----"
"MIIEzTCCAzWgAwIBAgIQWJrFD+oJ8vAQxzfzG4XeRDANBgkqhkiG9w0BAQsFADB/"
"MR4wHAYDVQQKExVta2NlcnQgZGV2ZWxvcG1lbnQgQ0ExKjAoBgNVBAsMIWF6dWNo"
"QGF6dWNoLUhQLTI0NS1HOC1Ob3RlYm9vay1QQzExMC8GA1UEAwwobWtjZXJ0IGF6"
"dWNoQGF6dWNoLUhQLTI0NS1HOC1Ob3RlYm9vay1QQzAeFw0yNTEyMzAwNzEyMjRa"
"Fw0zNTEyMzAwNzEyMjRaMH8xHjAcBgNVBAoTFW1rY2VydCBkZXZlbG9wbWVudCBD"
"QTEqMCgGA1UECwwhYXp1Y2hAYXp1Y2gtSFAtMjQ1LUc4LU5vdGVib29rLVBDMTEw"
"LwYDVQQDDChta2NlcnQgYXp1Y2hAYXp1Y2gtSFAtMjQ1LUc4LU5vdGVib29rLVBD"
"MIIBojANBgkqhkiG9w0BAQEFAAOCAY8AMIIBigKCAYEAtMJWaQ8iSym/ZA1/i/wV"
"VyeNMBGUirVdH1YRRM6UfwRs9gYYVY0WQL4EMHGlO5j8ZVPiSxc9bzJDjdac48Yl"
"sJtzdblWYLrv2KhCnuOhMAv0P8np/gRU832Q0X+0u0K6lL++cbWk1DIgV71sX67F"
"1WAt25CWw1J6EDgcTWK1M5EK9f7NINIQZkRhkDzTW8Q5GivWXcS+GFxlYftOs70L"
"Hqlgt25Ix11BaTzCtu7Parvqk1DoA5LH5k4OX69heVivOCq7VFrPKW3x2pZmgMC6"
"HffI0tM7xKjegBiDWsrHvTvvEdUHmORHSEbJZxj+rP2xJ2IZmiLORXOSr8wENK7d"
"vRgd7XGvre5WGqLtt0gVWxMw8xoA8xkEo5I9gGq39SDMVnPn+h2k8DI75wTIIFkL"
"LyejIBRblO/xHMjbA48vGNAda3PGPcHCP35i32RXaBLsUaNHF5vfBTi8wwWkQAgA"
"yBplcXuh8UHIxiVeXFTdTZwOlp6gMKsn06IeVuNNfq3/AgMBAAGjRTBDMA4GA1Ud"
"DwEB/wQEAwICBDASBgNVHRMBAf8ECDAGAQH/AgEAMB0GA1UdDgQWBBR1+e2kCjEK"
"jIqN5zVl2iNsO03sBTANBgkqhkiG9w0BAQsFAAOCAYEAEQ3Yh870wjnM8wRSObiR"
"x7lC2x+zexKLEpD431opc9S2CQOKd14gVpVXBh9HueP01nmh11rYzuEPW5694gVM"
"CkZkhqyYdKqueXcOtMpBgguMLw6h9PJrXpedr4bHt4sUQMjmKWTCGApSH9mW87YD"
"iaPlE0qz4lAgzT0xTLOq+I/FGxvS4n9U7PCuyGrmcWCmPHxvXrHwIWRRHEsHgBYo"
"4uUO8hP7xYTpqwh+cEsfTIq0TkUGGfhkC41uqR19031muueGghEHC70NX347wL13"
"Q6sY5ltqjqJW0hGjX+X8p30pQ+iW1LIPh7WdbIEvRkRrz23+c6Vvc++VR2LrinR2"
"LWnZt+uiWOXcTdbMqpw5VEvDl3nzu27PnGUBJQ10KN5NxEzx0VAsROZND7SRFa6d"
"gCJjZx8HyiJlLID1GeV1FBsgHdZRBFdBL/38Ts3z21Y7dvWxBDhPiHbLBKAxre3J"
"51iH17Gtolkj2eSPGzKOsr0W15aEy+yPplszq3SjwSto"
"-----END CERTIFICATE-----";
```

## src/http_fsm.c
```c
#include "http_fsm.h"
#include "wifi_fsm.h"
#include "sensor_fsm.h"
#include "http_transport.h"

#include <zephyr/kernel.h>
#include <zephyr/net/socket.h>
#include <zephyr/logging/log.h>

#include <string.h>
#include <stdint.h>
#include <stdio.h>

#define HTTP_BACKOFF_MS 2000

LOG_MODULE_REGISTER(HTTP_FSM, LOG_LEVEL_INF);

enum http_state {
	HTTP_STATE_INIT,
	HTTP_STATE_IDLE,
	HTTP_STATE_SEND,
	HTTP_STATE_BACKOFF,
};

static struct {
	enum http_state state;
	uint64_t backoff_until;
} http_ctx;


//Define a state_to_str helper

static char* state_to_str(enum http_state s) {
        switch(s) {
		case HTTP_STATE_INIT:		return "INIT";
                case HTTP_STATE_IDLE:         return "IDLE";
                case HTTP_STATE_SEND:         return "SEND";
                case HTTP_STATE_BACKOFF:     return "BACKOFF";
                default:                        return "UNKNOWN";

        }
}
//Define a set_state helper

static void set_state(enum http_state next) {
        if (http_ctx.state != next) {
                LOG_INF("State %s -> %s", state_to_str(http_ctx.state), state_to_str(next));
                http_ctx.state = next;
        }
}

void http_fsm_init(void) {
	if (http_transport_init() != 0) {
		LOG_ERR("Failed to initialize HTTP transport");
		// Handle initialization failure, maybe by moving to an error state
	}
	LOG_INF("HTTP FSM initialized.");
	http_ctx.state = HTTP_STATE_INIT;
}

void http_fsm_step(void) {

	struct sensor_sample sample;
	char data[64];

	switch (http_ctx.state) {
		case HTTP_STATE_INIT:
			if(wifi_is_connected()) {
				set_state(HTTP_STATE_IDLE);
			}
			break;
		case HTTP_STATE_IDLE:
			if(sensor_data_available()) {
				set_state(HTTP_STATE_SEND);
			}
			break;
		case HTTP_STATE_SEND:
			if (sensor_data_get(&sample)) {
				snprintf(data, sizeof(data), "{\"value\": %d}", sample.value);

				if (http_transport_send(data) >= 0) {
					LOG_INF("HTTP transport operation successful");
					set_state(HTTP_STATE_IDLE);
					break; // Break only on success
				}
				LOG_WRN("HTTP transport operation failed, entering backoff");
			}

			http_ctx.backoff_until = k_uptime_get() + HTTP_BACKOFF_MS;
			set_state(HTTP_STATE_BACKOFF);
			break;
		case HTTP_STATE_BACKOFF:
			if(k_uptime_get() >= http_ctx.backoff_until) {
				set_state(HTTP_STATE_INIT);
			}
			break; // Always break
	}
}
```

## src/http_fsm.h
```c
#pragma once

void http_fsm_init(void);
void http_fsm_step(void);
```

## src/http_transport.c
```c
#include "http_transport.h"
#include "ca_certificate.h" // Generated by shell script

#include <zephyr/kernel.h>
#include <zephyr/logging/log.h>

#include <zephyr/net/net_event.h>
#include <zephyr/net/net_if.h>
#include <errno.h>
#include <string.h>

#include <zephyr/net/net_ip.h>
#include <zephyr/net/socket.h>
#include <zephyr/net/http/client.h>
#include <zephyr/net/tls_credentials.h>

#include <zephyr/posix/sys/socket.h>
#include <zephyr/posix/unistd.h>
#include <zephyr/posix/netdb.h>
#include <zephyr/posix/arpa/inet.h>

LOG_MODULE_REGISTER(HTTP_TRANSPORT, LOG_LEVEL_INF);

#define TLS_PEER_HOSTNAME "www.google.com"
#define HTTP_PORT "80"
#define HTTPS_PORT "443"

#define TLS_SEC_TAG 42

static uint8_t recv_buf[1024];

/* HTTP response callback */
static int response_cb(struct http_response *rsp,
		       enum http_final_call final_data,
		       void *user_data)
{
	if (final_data == HTTP_DATA_MORE) {
		LOG_INF("Partial data received (%zd bytes)", rsp->data_len);
	} else if (final_data == HTTP_DATA_FINAL) {
		LOG_INF("All the data received (%zd bytes)", rsp->data_len);
	}

	LOG_INF("Response status %s", rsp->http_status);

	return 0;
}


int http_transport_init(void)
{
	if (IS_ENABLED(CONFIG_NET_SOCKETS_SOCKOPT_TLS)) {
		int ret = tls_credential_add(TLS_SEC_TAG,
					     TLS_CREDENTIAL_CA_CERTIFICATE,
					     ca_certificate,
					     sizeof(ca_certificate));
		if (ret < 0) {
			LOG_ERR("Failed to register CA certificate: %d", ret);
			return ret;
		}
		LOG_INF("CA certificate registered.");
	}
	return 0;
}

int http_transport_send(const char *payload)
{
	int sock = -1;
	int ret;
	struct addrinfo *res;
	struct addrinfo hints;
	const char *port_str;

	bool use_tls = IS_ENABLED(CONFIG_NET_SOCKETS_SOCKOPT_TLS);

	if (use_tls) {
		port_str = HTTPS_PORT;
	} else {
		port_str = HTTP_PORT;
	}

	(void)memset(&hints, 0, sizeof(hints));

	if (IS_ENABLED(CONFIG_NET_IPV4)) {
		hints.ai_family = AF_INET;
	} else if (IS_ENABLED(CONFIG_NET_IPV6)) {
		hints.ai_family = AF_INET6;
	} else {
		hints.ai_family = AF_UNSPEC;
	}
	hints.ai_socktype = SOCK_STREAM;

	LOG_INF("Resolving hostname: %s", TLS_PEER_HOSTNAME);
	ret = getaddrinfo(TLS_PEER_HOSTNAME, port_str, &hints, &res);
	if (ret != 0) {
		LOG_ERR("getaddrinfo failed: %d", ret);
		return -EIO;
	}

	if (res == NULL) {
		LOG_ERR("Could not resolve hostname");
		return -ENOENT;
	}

	if (use_tls) {
		sec_tag_t sec_tag_list[] = {
			TLS_SEC_TAG,
		};
		sock = socket(res->ai_family, res->ai_socktype, IPPROTO_TLS_1_2);
		if (sock >= 0) {
			ret = setsockopt(sock, SOL_TLS, TLS_SEC_TAG_LIST,
					 sec_tag_list, sizeof(sec_tag_list));
			if (ret < 0) {
				LOG_ERR("Failed to set TLS_SEC_TAG_LIST option: %d", -errno);
				ret = -errno;
			}

			ret = setsockopt(sock, SOL_TLS, TLS_HOSTNAME,
					 TLS_PEER_HOSTNAME, sizeof(TLS_PEER_HOSTNAME));
			if (ret < 0) {
				LOG_ERR("Failed to set TLS_HOSTNAME option: %d", -errno);
				ret = -errno;
			}
		}
	} else {
		sock = socket(res->ai_family, res->ai_socktype, res->ai_protocol);
	}

	if (sock < 0) {
		LOG_ERR("Failed to create socket: %d", -errno);
		freeaddrinfo(res);
		return -errno;
	}

	LOG_INF("Connecting to server...");
	ret = connect(sock, res->ai_addr, res->ai_addrlen);
	if (ret < 0) {
		LOG_ERR("connect failed: %d", -errno);
		close(sock);
		freeaddrinfo(res);
		return -errno;
	}

	LOG_INF("Connected!");

	char host_with_port[256];
	snprintf(host_with_port, sizeof(host_with_port), "%s:%s", TLS_PEER_HOSTNAME, port_str);

	struct http_request req;
	memset(&req, 0, sizeof(req));

	req.method = HTTP_GET;
	req.url = "/";
	req.host = host_with_port;
	req.protocol = "HTTP/1.1";
	// The payload is ignored for GET requests, but we clear it for consistency
	req.payload = NULL;
	req.payload_len = 0;
	req.response = response_cb;
	req.recv_buf = recv_buf;
	req.recv_buf_len = sizeof(recv_buf);

	LOG_INF("Sending HTTP %s request...", http_method_str(req.method));
	ret = http_client_req(sock, &req, 5000, NULL);
	if (ret < 0) {
		LOG_ERR("http_client_req failed: %d", ret);
	} else {
		LOG_INF("HTTP request sent successfully.");
	}

	close(sock);
	freeaddrinfo(res);

	return ret;
}
```

## src/http_transport.h
```c
#pragma once

#include <stddef.h>

/**
 * @brief Initializes the HTTP transport layer.
 *
 * This function sets up necessary resources, such as TLS credentials.
 * It should be called once before any send operations.
 *
 * @return 0 on success, or a negative error code on failure.
 */
int http_transport_init(void);

/**
 * @brief Sends data over HTTP or HTTPS.
 *
 * This function resolves the hostname, establishes a connection, and sends
 * the provided payload. The transport (HTTP/HTTPS) and IP version (IPv4/IPv6)
 * are determined by the project's Kconfig settings.
 *
 * @param payload The data to send. If NULL or empty, a GET request is sent.
 *                Otherwise, a POST request is sent.
 *
 * @return 0 on success, or a negative error code on failure.
 */
int http_transport_send(const char *payload);
```

## src/sensor_fsm.c
```c
#include "sensor_fsm.h"
#include <zephyr/kernel.h>
#include <zephyr/logging/log.h>

LOG_MODULE_REGISTER(sensor_fsm, LOG_LEVEL_INF);
#define SENSOR_MAX_RETRY 3
//Define enum event for sensor

enum sensor_event {
	SENSOR_EVENT_NONE = 0,
	SENSOR_EVENT_INIT_DONE,
	SENSOR_EVENT_READ_DONE,
	SENSOR_EVENT_ERROR,
};


//Define struct stage for sensor

enum sensor_state {
	SENSOR_STATE_INIT,
	SENSOR_STATE_READ,
	SENSOR_STATE_IDLE,
	SENSOR_STATE_ERROR,
	SENSOR_STATE_RECOVERY,
};


//Define context for sensor

static struct {
	enum sensor_state state;
	uint8_t retry_count;
} sensor_ctx;

//Create sensor_data_q

K_MSGQ_DEFINE(sensor_data_q, sizeof(struct sensor_sample), 10, 4);

//Define function sensor_data_available()

bool sensor_data_available(void) {
	return (k_msgq_num_used_get(&sensor_data_q) > 0);
}

//Define function sensor_data_get()

bool sensor_data_get(struct sensor_sample *out) {
	return (k_msgq_get(&sensor_data_q, out, K_NO_WAIT) == 0);
}

//Define function sensor_hw_init()
//Let simulate the hardware/sensor init
bool sensor_hw_init(void) {
	return true;	
}

//Define function sensor_hw_read()

static bool sensor_hw_read(struct sensor_sample *out) {
	static int counter;
	counter++;

	if (counter % 5 == 0) {
		return false;
	}

	out->value = counter * 10;
	k_msgq_put(&sensor_data_q, out, K_NO_WAIT);
	LOG_INF("Readed: %d", counter);
	return true;
}

//Define function sensor_fsm_init()

void sensor_fsm_init(void) {
	sensor_ctx.state = SENSOR_STATE_INIT;
	sensor_ctx.retry_count = 0;
	LOG_INF("Sensor fsm initialized");
}

//Define a state_to_str helper

static char* state_to_str(enum sensor_state s) {
	switch(s) {
		case SENSOR_STATE_INIT: 	return "INIT";
		case SENSOR_STATE_IDLE:		return "IDLE";
		case SENSOR_STATE_ERROR:	return "ERROR";
		case SENSOR_STATE_READ: 	return "READ";
		case SENSOR_STATE_RECOVERY:	return "RECOVERY";
		default:			return "UNKNOWN";
	
	}
}
//Define a set_state helper

static void set_state(enum sensor_state next) {
	if (sensor_ctx.state != next) {
		LOG_INF("State %s -> %s", state_to_str(sensor_ctx.state), state_to_str(next));
		sensor_ctx.state = next;
	}
}

//Define function sensor_fsm_step()

void sensor_fsm_step(void) {
	struct sensor_sample sample;

	switch (sensor_ctx.state) {
		case SENSOR_STATE_INIT:
			if(!sensor_hw_init()) {
				set_state(SENSOR_STATE_ERROR);
				break;
			}
			set_state(SENSOR_STATE_READ);
			break;
		case SENSOR_STATE_READ:
			if (!sensor_hw_read(&sample)) {
				set_state(SENSOR_STATE_ERROR);
				break;
			}
			set_state(SENSOR_STATE_IDLE);
			break;
		case SENSOR_STATE_IDLE:
			k_msleep(2000);
			set_state(SENSOR_STATE_READ);
			break;
		case SENSOR_STATE_ERROR:
			sensor_ctx.retry_count++;
			if (sensor_ctx.retry_count <= SENSOR_MAX_RETRY) {
				set_state(SENSOR_STATE_IDLE);
			} else {
				set_state(SENSOR_STATE_RECOVERY);
			}
			break;
		case SENSOR_STATE_RECOVERY:
			set_state(SENSOR_STATE_INIT);
			break;
		}
}
```

## src/sensor_fsm.h
```c
#pragma once
#include <stdint.h>
#include <stdbool.h>

struct sensor_sample {
	int32_t value;
};

void sensor_fsm_init(void);

void sensor_fsm_step(void);

bool sensor_data_available(void);
bool sensor_data_get(struct sensor_sample *out);
```

## src/system_event.c
```c
#include "system_event.h"
#include <zephyr/kernel.h>

K_MSGQ_DEFINE(system_event_q, sizeof(enum system_event), 8, 4);

void system_event_post(enum system_event evt) {
	k_msgq_put(&system_event_q, &evt, K_NO_WAIT);
}

int system_event_get(enum system_event *evt) {
	return k_msgq_get(&system_event_q, evt, K_FOREVER);
}
```

## src/system_event.h
```c
#pragma once

enum system_event {
	EVENT_OK = 0,
	EVENT_START,
};

void system_event_post(enum system_event);
int system_event_get(enum system_event *evt);
```

## src/wifi_fsm.c
```c
#include "wifi_fsm.h"

#include <stdint.h>

#include <zephyr/net/net_if.h>
#include <zephyr/net/net_mgmt.h>
#include <zephyr/net/wifi_mgmt.h>
#include <zephyr/kernel.h>

#include <zephyr/logging/log.h>

#define WIFI_BACKOFF_MS 10000

#define SSID CONFIG_APP_WIFI_SSID
#define PSK CONFIG_APP_WIFI_PSK

LOG_MODULE_REGISTER(WIFI_FSM, LOG_LEVEL_INF);

enum wifi_state {
	WIFI_STATE_CONNECTED,
	WIFI_STATE_CONNECTING,
	WIFI_STATE_INIT,
	WIFI_STATE_BACKOFF,
};

static struct {
	enum wifi_state state;
	uint8_t retry_count;
	uint64_t backoff_untill;
	bool connected;
} wifi_ctx;

static struct net_mgmt_event_callback wifi_mgmt_cb;
static void set_state(enum wifi_state next);
static char *state_to_str(enum wifi_state s);


static void wifi_mgmt_handler (struct net_mgmt_event_callback *cb,
				uint64_t mgmt_event,
				struct net_if *iface) {
	switch (mgmt_event) {
		case NET_EVENT_WIFI_CONNECT_RESULT:
			set_state(WIFI_STATE_CONNECTED);
			break;
		case NET_EVENT_WIFI_DISCONNECT_RESULT:
			set_state(WIFI_STATE_BACKOFF);
			wifi_ctx.backoff_untill = k_uptime_get() + WIFI_BACKOFF_MS;
			break;
		default:
			break;
	}
}

static char* state_to_str(enum wifi_state s) {
	switch(s) {
		case WIFI_STATE_INIT: 		return "INIT";
		case WIFI_STATE_CONNECTING:	return "CONNECTING";
		case WIFI_STATE_CONNECTED:	return "CONNECTED";
		case WIFI_STATE_BACKOFF: 	return "BACKOFF";
		default:			return "UNKNOWN";

	}
}

void set_state(enum wifi_state next) {
	if (wifi_ctx.state != next) {
		LOG_INF("State %s -> %s", state_to_str(wifi_ctx.state), state_to_str(next));
		wifi_ctx.state = next;
	}
}


bool wifi_is_connected(void) {
	return wifi_ctx.connected;
}

void wifi_fsm_init(void) {
	wifi_ctx.connected = false;
	wifi_ctx.state = WIFI_STATE_INIT;
	
	//Create network callback on wifi CONNECT and DISCONNECT event
	net_mgmt_init_event_callback(&wifi_mgmt_cb, wifi_mgmt_handler, NET_EVENT_WIFI_CONNECT_RESULT | NET_EVENT_WIFI_DISCONNECT_RESULT);
	//Assign new callback
	net_mgmt_add_event_callback(&wifi_mgmt_cb);
	//LOG it
	LOG_INF("WIFI FSM is initialized.");
}

void wifi_fsm_step(void) {

	switch(wifi_ctx.state) {
		case WIFI_STATE_INIT:
			//For send request
			struct net_if *iface = net_if_get_default();
			struct wifi_connect_req_params params;

			memset(&params, 0, sizeof(params));

			params.ssid = SSID;
			params.psk = PSK;
			params.ssid_length = sizeof(SSID);
			params.psk_length = sizeof(PSK);
			params.security = WIFI_SECURITY_TYPE_PSK;
			params.channel = WIFI_CHANNEL_ANY;
			params.band = WIFI_FREQ_BAND_2_4_GHZ;

			net_mgmt(NET_REQUEST_WIFI_CONNECT, iface, &params, sizeof(params));
			set_state(WIFI_STATE_CONNECTING);
			break;
		case WIFI_STATE_CONNECTING:
			//Keep waiting
			break;
		case WIFI_STATE_CONNECTED:
			wifi_ctx.connected = true;
			break;
		case WIFI_STATE_BACKOFF:
			wifi_ctx.connected = false;

			if(k_uptime_get() >= wifi_ctx.backoff_untill) {
				set_state(WIFI_STATE_INIT);
			}
			break;
		default:
			break;
	}
}
```
